## Embedded_Linux/Auto_Build_Tools/Yocto/Distro_Specializations/custom-yocto-meta-nada/meta-nada/conf/distro/almaza.conf
```bitbake
include home/nada/poky/meta-poky/conf/distro/poky.conf

DISTRO = "almaza"
DISTRO_NAME = "Almaza"
#DISTRO_VERSION = "3.4+snapshot-${METADATA_REVISION}"
DISTRO_VERSION = "4.0.20"
DISTRO_CODENAME = "kirkstone"

MAINTAINER = "nadaelsayedhassan3@gmail.com"

# this will let you run as systemd
DISTRO_FEATURES:append = " systemd"
VIRTUAL-RUNTIME_init_manager = "systemd"

DISTRO_FEATURES_BACKFILL_CONSIDERED:append = " sysvinit"
VIRTUAL-RUNTIME_initscripts = "systemd-compat-units"
VIRTUAL-RUNTIME_login_manager = "shadow-base"
VIRTUAL-RUNTIME_dev_manager = "systemd"
```

## Embedded_Linux/Auto_Build_Tools/Yocto/Distro_Specializations/meta-nada/conf/distro/almaza.conf
```bitbake
include home/nada/poky/meta-poky/conf/distro/poky.conf

DISTRO = "almaza"
DISTRO_NAME = "Almaza"
#DISTRO_VERSION = "3.4+snapshot-${METADATA_REVISION}"
DISTRO_VERSION = "4.0.20"
DISTRO_CODENAME = "kirkstone"

MAINTAINER = "nadaelsayedhassan3@gmail.com"

ALMAZA_DEFAULT_DISTRO_FEATURES = "largefile opengl ptest multiarch wayland vulkan ssh wifi qt5 x11"

DISTRO_FEATURES ?= "${DISTRO_FEATURES_DEFAULT} ${ALMAZA_DEFAULT_DISTRO_FEATURES}"

# this will let you run as systemd
DISTRO_FEATURES:append = " systemd"
VIRTUAL-RUNTIME_init_manager = "systemd"

DISTRO_FEATURES_BACKFILL_CONSIDERED:append = " sysvinit"
VIRTUAL-RUNTIME_initscripts = "systemd-compat-units"
VIRTUAL-RUNTIME_login_manager = "shadow-base"
VIRTUAL-RUNTIME_dev_manager = "systemd"
```

## Embedded_Linux/Auto_Build_Tools/Yocto/yocto/meta-nada/conf/layer.conf
```bitbake
# We have a conf and classes directory, add to BBPATH
BBPATH .= ":${LAYERDIR}"

# We have recipes-* directories, add to BBFILES
BBFILES += "${LAYERDIR}/recipes-*/*/*.bb \
            ${LAYERDIR}/recipes-*/*/*.bbappend"

BBFILES:append = " ${LAYERDIR}/nada-*/*/*.bb "

#BBFILES = "${LAYERDIR}/nada-recipes/*/*.bb"


BBFILE_COLLECTIONS += "meta-nada"
BBFILE_PATTERN_meta-nada = "^${LAYERDIR}/"
BBFILE_PRIORITY_meta-nada = "6"

LAYERDEPENDS_meta-nada = "core"
LAYERSERIES_COMPAT_meta-nada = "kirkstone"

# Expose BANNER_VARIABLE to the BitBake environment
BB_ENV_PASSTHROUGH_ADDITIONS += "BANNER_VARIABLE"
```
